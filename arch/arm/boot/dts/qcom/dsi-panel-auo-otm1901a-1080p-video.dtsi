/* Copyright (c) 2013, The Linux Foundation. All rights reserved.
 *
 * This program is free software; you can redistribute it and/or modify
 * it under the terms of the GNU General Public License version 2 and
 * only version 2 as published by the Free Software Foundation.
 *
 * This program is distributed in the hope that it will be useful,
 * but WITHOUT ANY WARRANTY; without even the implied warranty of
 * MERCHANTABILITY or FITNESS FOR A PARTICULAR PURPOSE.  See the
 * GNU General Public License for more details.
 */

/*---------------------------------------------------------------------------
 * This file is autogenerated file using gcdb parser. Please do not edit it.
 * Update input XML file to add a new entry or update variable in this file
 * VERSION = "1.0"
 *---------------------------------------------------------------------------*/
&mdss_mdp {
	dsi_auo_otm1901a_1080p_video: qcom,mdss_dsi_auo_otm1901a_1080p_video {
		qcom,mdss-dsi-panel-name = "auo otm1901a 1080p video mode dsi panel";
		qcom,mdss-dsi-panel-controller = <&mdss_dsi0>;
		qcom,mdss-dsi-panel-type = "dsi_video_mode";
		qcom,mdss-dsi-panel-destination = "display_1";
		qcom,mdss-dsi-panel-framerate = <60>;
		qcom,mdss-dsi-virtual-channel-id = <0>;
		qcom,mdss-dsi-stream = <0>;
		qcom,mdss-dsi-panel-width = <1080>;
		qcom,mdss-dsi-panel-height = <1920>;
		qcom,mdss-dsi-h-front-porch = <52>;
		qcom,mdss-dsi-h-back-porch = <52>;
		qcom,mdss-dsi-h-pulse-width = <4>;
		qcom,mdss-dsi-h-sync-skew = <0>;
		qcom,mdss-dsi-v-back-porch = <7>;
		qcom,mdss-dsi-v-front-porch = <8>;
		qcom,mdss-dsi-v-pulse-width = <1>;
		qcom,mdss-dsi-h-left-border = <0>;
		qcom,mdss-dsi-h-right-border = <0>;
		qcom,mdss-dsi-v-top-border = <0>;
		qcom,mdss-dsi-v-bottom-border = <0>;
		qcom,mdss-dsi-bpp = <24>;
		qcom,mdss-dsi-color-order = "rgb_swap_rgb";
		qcom,mdss-dsi-underflow-color = <0xff>;
		qcom,mdss-dsi-border-color = <0>;
		qcom,mdss-dsi-on-command = [29 01 00 00 00 00 02 00 00
	29 01 00 00 0A 00 05 FF 19 01 01 00
	29 01 00 00 00 00 02 00 80
	29 01 00 00 0A 00 03 FF 19 01
	29 01 00 00 00 00 02 00 00
	29 01 00 00 00 00 19 E1 0C 19 1F 2C 31 3A 44 54 5D 70 7C 83 77 73 6C 5C 49 38 2B 25 1A 13 07 02
	29 01 00 00 00 00 02 00 00
	29 01 00 00 00 00 19 E2 04 0F 1A 28 2E 35 40 51 5A 6D 78 81 77 70 6A 58 46 34 27 21 16 11 05 00
	29 01 00 00 00 00 02 00 00
	29 01 00 00 00 00 19 E3 0C 19 1F 2C 31 3A 44 54 5D 70 7C 83 77 73 6C 5C 49 38 2B 25 1A 13 07 02
	29 01 00 00 00 00 02 00 00
	29 01 00 00 00 00 19 E4 04 0F 1A 28 2E 35 40 51 5A 6D 78 81 77 70 6A 58 46 34 27 21 16 11 05 00
	29 01 00 00 00 00 02 00 00
	29 01 00 00 00 00 19 E5 0C 19 1F 2C 31 3A 44 54 5D 70 7C 83 77 73 6C 5C 49 38 2B 25 1A 13 07 02
	29 01 00 00 00 00 02 00 00
	29 01 00 00 00 00 19 E6 04 0F 1A 28 2E 35 40 51 5A 6D 78 81 77 70 6A 58 46 34 27 21 16 11 05 00
	29 01 00 00 00 00 02 00 00
	29 01 00 00 00 00 22 EC 50 44 53 44 44 44 44 44 44 44 44 44 44 44 44 44 44 44 44 44 44 44 44 44 44 44 44 44 44 44 44 44 03
	29 01 00 00 00 00 02 00 00
	29 01 00 00 00 00 22 ED 50 44 53 44 44 44 44 44 44 44 44 44 44 44 44 44 44 44 44 44 44 44 44 44 44 44 44 44 44 44 44 44 03
	29 01 00 00 00 00 02 00 00
	29 01 00 00 00 00 22 EE 50 44 53 44 44 44 44 44 44 44 44 44 44 44 44 44 44 44 44 44 44 44 44 44 44 44 44 44 44 44 44 44 03
	29 01 00 00 00 00 02 00 B0
	29 01 00 00 00 00 02 CA 04
	29 01 00 00 00 00 02 00 B3
	29 01 00 00 00 00 02 CA 48
	29 01 00 00 00 00 02 00 90
				29 01 00 00 00 00 0A CA E8 FF 87 FF 87 FF 53 53 53
				29 01 00 00 00 00 02 00 00
				29 01 00 00 00 00 02 C6 10
				29 01 00 00 00 00 13 C7 80 CC CA AB A9 DC BA BB DA AB BC CB EA FF 8F 67 45 23
				29 01 00 00 00 00 02 00 00
				29 01 00 00 00 00 02 C6 11
				29 01 00 00 00 00 13 C7 80 BC BA AB 99 CC AA BB BB 9C DA AB CA FF 8F 67 45 23
				29 01 00 00 00 00 02 00 00
				29 01 00 00 00 00 02 C6 12
				29 01 00 00 00 00 13 C7 80 BB AA 9C 99 CC A9 BA BA AB BA AB CA FC 8F 67 45 23
				29 01 00 00 00 00 02 00 00
				29 01 00 00 00 00 02 C6 13
				29 01 00 00 00 00 13 C7 80 AB AA AB 98 CB A9 AA AA AB AA AB C9 BB 8F 67 45 23
				29 01 00 00 00 00 02 00 00
				29 01 00 00 00 00 02 C6 14
				29 01 00 00 00 00 13 C7 80 AB A9 9B 89 CB A8 AA 9A AB A9 AA BA BA 8F 67 45 23
				29 01 00 00 00 00 02 00 00
				29 01 00 00 00 00 02 C6 15
				29 01 00 00 00 00 13 C7 80 AA A9 AA 88 BB 99 9A AA A9 AA A9 B9 AA 8A 67 45 23 
				29 01 00 00 00 00 02 00 00
				29 01 00 00 00 00 02 C6 16
				29 01 00 00 00 00 13 C7 80 9A 9A 9A 89 C9 A8 99 AA A8 AA 99 B9 A9 89 67 45 23
				29 01 00 00 00 00 02 00 00
				29 01 00 00 00 00 02 C6 17
				29 01 00 00 00 00 13 C7 80 A9 99 9A 98 B9 98 99 AA 98 AA 89 B9 99 89 67 45 23
				29 01 00 00 00 00 02 00 00
				29 01 00 00 00 00 02 C6 18
				29 01 00 00 00 00 13 C7 70 9A 99 A9 88 C8 98 99 A9 98 B9 88 B8 8A 89 67 45 23
				29 01 00 00 00 00 02 00 00
				29 01 00 00 00 00 02 C6 19
				29 01 00 00 00 00 13 C7 70 9A A8 98 89 B8 98 89 A9 98 A9 79 B8 99 88 67 45 23
				29 01 00 00 00 00 02 00 00
				29 01 00 00 00 00 02 C6 1A
				29 01 00 00 00 00 13 C7 70 8A 99 89 89 B8 88 89 99 89 99 89 B7 89 88 78 46 23
				29 01 00 00 00 00 02 00 00 
				29 01 00 00 00 00 02 C6 1B
				29 01 00 00 00 00 13 C7 70 99 98 89 89 A8 88 89 89 89 A8 89 97 8A 88 88 57 34
				29 01 00 00 00 00 02 00 00
				29 01 00 00 00 00 02 C6 1C
				29 01 00 00 00 00 13 C7 80 89 98 89 89 A8 88 89 89 89 A8 89 97 8A 88 88 57 34
				29 01 00 00 00 00 02 00 00
				29 01 00 00 00 00 02 C6 1D
				29 01 00 00 00 00 13 C7 80 88 89 89 88 A8 88 89 98 88 99 89 97 89 88 88 68 45
				29 01 00 00 00 00 02 00 00
				29 01 00 00 00 00 02 C6 1E
				29 01 00 00 00 00 13 C7 80 88 98 88 98 A7 88 88 98 88 98 99 87 89 88 88 78 56
				29 01 00 00 00 00 02 00 00
				29 01 00 00 00 00 02 C6 1F
				29 01 00 00 00 00 13 C7 80 88 88 88 88 89 88 88 88 88 98 98 87 89 88 88 88 68
				29 01 00 00 00 00 02 00 00
				29 01 00 00 00 00 02 C6 00
	29 01 00 00 00 00 02 00 00
	29 01 00 00 00 00 04 FF FF FF FF 					
				29 01 00 00 00 00 02 51 23
				29 01 00 00 00 00 02 53 24
				29 01 00 00 00 00 02 5E 0C
				29 01 00 00 00 00 02 55 02
				05 01 00 00 78 00 02 11 00
					05 01 00 00 00 00 02 29 00];
		qcom,mdss-dsi-off-command = [05 01 00 00 32 00 02 10 00
					29 01 00 00 00 00 02 53 00
					05 01 00 00 0A 00 02 28 00];
		qcom,mdss-dsi-on-command-state = "dsi_lp_mode";
		qcom,mdss-dsi-off-command-state = "dsi_lp_mode";
		qcom,mdss-dsi-h-sync-pulse = <1>;
		qcom,mdss-dsi-traffic-mode = "burst_mode";
		qcom,mdss-dsi-bllp-eof-power-mode;
		qcom,mdss-dsi-bllp-power-mode;
		qcom,mdss-dsi-lane-map = "lane_map_0123";
		qcom,mdss-dsi-lane-0-state;
		qcom,mdss-dsi-lane-1-state;
		qcom,mdss-dsi-lane-2-state;
		qcom,mdss-dsi-lane-3-state;
		qcom,mdss-dsi-panel-timings = [DB 36 22 00 62 66 28 3A 2B 03 04 00];
		qcom,mdss-dsi-t-clk-post = <0x03>;
		qcom,mdss-dsi-t-clk-pre = <0x29>;
		qcom,mdss-dsi-bl-min-level = <1>;
		qcom,mdss-dsi-bl-max-level = <255>;
		qcom,mdss-dsi-bl-pmic-pwm-frequency = <100>;
		qcom,mdss-dsi-bl-pmic-bank-select = <0>;
		qcom,mdss-dsi-dma-trigger = "trigger_sw";
		qcom,mdss-dsi-mdp-trigger = "none";
		qcom,mdss-dsi-bl-pmic-control-type = "bl_ctrl_dcs";
		qcom,mdss-dsi-reset-sequence = <1 1>, <0 1>, <1 5>;
		qcom,mdss-dsi-lp11-init;
		qcom,esd-check-enabled;
	        qcom,mdss-dsi-panel-status-command = [06 01 00 01 05 00 02 0A 00];
        	qcom,mdss-dsi-panel-status-command-state = "dsi_hs_mode";
	        qcom,mdss-dsi-panel-status-check-mode = "reg_read";
        	qcom,mdss-dsi-panel-status-value = <0x9C>;
		qcom,mdss-pan-physical-width-dimension = <74>; //width of picture in mm (for xdpi)
		qcom,mdss-pan-physical-height-dimension = <132>; //height of picture in mm (for ydpi)
	};
};
