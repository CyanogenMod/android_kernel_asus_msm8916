/* Copyright (c) 2013-2014, The Linux Foundation. All rights reserved.
 *
 * This program is free software; you can redistribute it and/or modify
 * it under the terms of the GNU General Public License version 2 and
 * only version 2 as published by the Free Software Foundation.
 *
 * This program is distributed in the hope that it will be useful,
 * but WITHOUT ANY WARRANTY; without even the implied warranty of
 * MERCHANTABILITY or FITNESS FOR A PARTICULAR PURPOSE.  See the
 * GNU General Public License for more details.
 */

/*---------------------------------------------------------------------------
 * This file is autogenerated file using gcdb parser. Please do not edit it.
 * Update input XML file to add a new entry or update variable in this file
 * VERSION = "1.0"
 *---------------------------------------------------------------------------*/
&mdss_mdp {
	dsi_cpt_ili9881c_720p_video: qcom,mdss_dsi_cpt_ili9881c_720p_video {
		qcom,mdss-dsi-panel-name = "cpt ili9881c 720p video mode dsi panel";
		qcom,mdss-dsi-panel-controller = <&mdss_dsi0>;
		qcom,mdss-dsi-panel-type = "dsi_video_mode";
		qcom,mdss-dsi-panel-destination = "display_1";
		qcom,mdss-dsi-panel-framerate = <60>;
		qcom,mdss-dsi-virtual-channel-id = <0>;
		qcom,mdss-dsi-stream = <0>;
		qcom,mdss-dsi-panel-width = <720>;
		qcom,mdss-dsi-panel-height = <1280>;
		qcom,mdss-dsi-h-front-porch = <168>;
		qcom,mdss-dsi-h-back-porch = <160>;
		qcom,mdss-dsi-h-pulse-width = <8>;
		qcom,mdss-dsi-h-sync-skew = <0>;
		qcom,mdss-dsi-v-back-porch = <20>;
		qcom,mdss-dsi-v-front-porch = <8>;
		qcom,mdss-dsi-v-pulse-width = <8>;
		qcom,mdss-dsi-h-left-border = <0>;
		qcom,mdss-dsi-h-right-border = <0>;
		qcom,mdss-dsi-v-top-border = <0>;
		qcom,mdss-dsi-v-bottom-border = <0>;
		qcom,mdss-dsi-bpp = <24>;
		qcom,mdss-dsi-color-order = "rgb_swap_rgb";
		qcom,mdss-dsi-underflow-color = <0xff>;
		qcom,mdss-dsi-border-color = <0>;
		qcom,mdss-dsi-on-command = [29 01 00 00 00 00 04 FF 98 81 02
                                29 01 00 00 00 00 02 06 40
                                29 01 00 00 00 00 02 07 04
				29 01 00 00 00 00 02 03 48
				29 01 00 00 00 00 02 04 00	
				29 01 00 00 00 00 02 05 04
				29 01 00 00 00 00 04 FF 98 81 00
				29 01 00 00 00 00 03 51 02 30
				29 01 00 00 00 00 02 53 24
				29 01 00 00 00 00 03 5E 00 CF
				05 01 00 00 c8 00 02 11 00
				39 01 00 00 00 00 04 FF 98 81 04
				39 01 00 00 00 00 02 3A 24
				39 01 00 00 00 00 02 35 1F
				39 01 00 00 00 00 02 32 05
				39 01 00 00 00 00 04 FF 98 81 01
				39 01 00 00 00 00 02 63 00
				29 01 00 00 00 00 04 FF 98 81 00 
				05 01 00 00 46 00 02 29 00];
				qcom,mdss-dsi-off-command = [05 01 00 00 32 00 02 28 00 
				05 01 00 00 78 00 02 10 00];
		qcom,mdss-dsi-on-command-state = "dsi_lp_mode";
		qcom,mdss-dsi-off-command-state = "dsi_lp_mode";
		qcom,mdss-dsi-h-sync-pulse = <1>;
		qcom,mdss-dsi-traffic-mode = "burst_mode";
		qcom,mdss-dsi-bllp-eof-power-mode;
		qcom,mdss-dsi-bllp-power-mode;
		qcom,mdss-dsi-lane-0-state;
		qcom,mdss-dsi-lane-1-state;
		qcom,mdss-dsi-lane-2-state;
		qcom,mdss-dsi-lane-3-state;
		qcom,mdss-dsi-panel-timings = [8C 20 14 00 44 4A 18 24 18 03 04 00];
		qcom,mdss-dsi-t-clk-post = <0x04>;
		qcom,mdss-dsi-t-clk-pre = <0x1C>;
		qcom,mdss-dsi-bl-min-level = <1>;
		qcom,mdss-dsi-bl-max-level = <255>;
		qcom,mdss-dsi-bl-pmic-pwm-frequency = <100>;
		qcom,mdss-dsi-bl-pmic-bank-select = <0>;
		qcom,mdss-dsi-pwm-gpio = <&pm8916_mpps 4 0>;
		qcom,mdss-dsi-dma-trigger = "trigger_sw";
		qcom,mdss-dsi-mdp-trigger = "none";
		qcom,mdss-dsi-bl-pmic-control-type = "bl_ctrl_dcs";
		qcom,mdss-dsi-reset-sequence = <1 1>, <0 1>, <1 11>;
		qcom,mdss-dsi-lp11-init;
		qcom,esd-check-enabled;
	        qcom,mdss-dsi-panel-status-command = [06 01 00 01 05 00 02 0A 08];
        	qcom,mdss-dsi-panel-status-command-state = "dsi_lp_mode";
	        qcom,mdss-dsi-panel-status-check-mode = "reg_read";
        	qcom,mdss-dsi-panel-status-value = <0x9c>;
		qcom,mdss-pan-physical-width-dimension = <74>; //width of picture in mm (for xdpi)
		qcom,mdss-pan-physical-height-dimension = <132>; //height of picture in mm (for ydpi)
	};
};
