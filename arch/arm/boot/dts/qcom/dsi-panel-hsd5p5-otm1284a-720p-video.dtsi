/* Copyright (c) 2013, The Linux Foundation. All rights reserved.
 *
 * This program is free software; you can redistribute it and/or modify
 * it under the terms of the GNU General Public License version 2 and
 * only version 2 as published by the Free Software Foundation.
 *
 * This program is distributed in the hope that it will be useful,
 * but WITHOUT ANY WARRANTY; without even the implied warranty of
 * MERCHANTABILITY or FITNESS FOR A PARTICULAR PURPOSE.  See the
 * GNU General Public License for more details.
 */

/*---------------------------------------------------------------------------
 * This file is autogenerated file using gcdb parser. Please do not edit it.
 * Update input XML file to add a new entry or update variable in this file
 * VERSION = "1.0"
 *---------------------------------------------------------------------------*/
&mdss_mdp {
	dsi_hsd5p5_otm1284a_720p_video: qcom,mdss_dsi_hsd5p5_otm1284a_720p_video {
		qcom,mdss-dsi-panel-name = "hsd5.5 otm1284a 720p video mode dsi panel";
		qcom,mdss-dsi-panel-controller = <&mdss_dsi0>;
		qcom,mdss-dsi-panel-type = "dsi_video_mode";
		qcom,mdss-dsi-panel-destination = "display_1";
		qcom,mdss-dsi-panel-framerate = <60>;
		qcom,mdss-dsi-virtual-channel-id = <0>;
		qcom,mdss-dsi-stream = <0>;
		qcom,mdss-dsi-panel-width = <720>;
		qcom,mdss-dsi-panel-height = <1280>;
		qcom,mdss-dsi-h-front-porch = <64>;
		qcom,mdss-dsi-h-back-porch = <48>;
		qcom,mdss-dsi-h-pulse-width = <18>;
		qcom,mdss-dsi-h-sync-skew = <0>;
		qcom,mdss-dsi-v-back-porch = <14>;
		qcom,mdss-dsi-v-front-porch = <9>;
		qcom,mdss-dsi-v-pulse-width = <3>;
		qcom,mdss-dsi-h-left-border = <0>;
		qcom,mdss-dsi-h-right-border = <0>;
		qcom,mdss-dsi-v-top-border = <0>;
		qcom,mdss-dsi-v-bottom-border = <0>;
		qcom,mdss-dsi-bpp = <24>;
		qcom,mdss-dsi-color-order = "rgb_swap_rgb";
		qcom,mdss-dsi-underflow-color = <0xff>;
		qcom,mdss-dsi-border-color = <0>;
		qcom,mdss-dsi-on-command = [29 01 00 00 00 00 02 00 00
   29 01 00 00 00 00 04 FF 12 84 01
   29 01 00 00 00 00 02 00 80
   29 01 00 00 00 00 03 FF 12 84
   29 01 00 00 00 00 02 00 92
   29 01 00 00 00 00 03 FF 30 02
   29 01 00 00 00 00 02 00 80
   29 01 00 00 00 00 0A C0 00 64 00 10 10 00 64 10 10
   29 01 00 00 00 00 02 00 90
   29 01 00 00 00 00 07 C0 00 50 00 01 00 04
   29 01 00 00 00 00 02 00 A2
   29 01 00 00 00 00 02 C0 00
   29 01 00 00 00 00 02 00 A3
   29 01 00 00 00 00 02 C0 02
   29 01 00 00 00 00 02 00 A4
   29 01 00 00 00 00 02 C0 02
   29 01 00 00 00 00 02 00 C2
   29 01 00 00 00 00 02 F5 40
   29 01 00 00 00 00 02 00 C3
   29 01 00 00 00 00 02 F5 85
   29 01 00 00 00 00 02 00 B3
   29 01 00 00 00 00 03 C0 00 55
   29 01 00 00 00 00 02 00 81
   29 01 00 00 00 00 02 C1 55
   29 01 00 00 00 00 02 00 90
   29 01 00 00 00 00 02 C4 49
   29 01 00 00 00 00 02 00 B4
   29 01 00 00 00 00 02 C0 55
   29 01 00 00 00 00 02 00 00
   29 01 00 00 00 00 02 36 00
   29 01 00 00 00 00 02 00 B0
   29 01 00 00 00 00 03 C4 00 00
   29 01 00 00 00 00 02 00 91
   29 01 00 00 00 00 03 C5 46 42
   29 01 00 00 00 00 02 00 00
   29 01 00 00 00 00 03 D8 CF CF
   29 01 00 00 00 00 02 00 80
   29 01 00 00 00 00 03 C4 00 80
   29 01 00 00 00 00 02 00 B3
   29 01 00 00 00 00 02 C5 84
   29 01 00 00 00 00 02 00 BB
   29 01 00 00 00 00 02 C5 8A
   29 01 00 00 00 00 02 00 82
   29 01 00 00 00 00 02 C4 0A
   29 01 00 00 00 00 02 00 C6
   29 01 00 00 00 00 02 B0 03
   29 01 00 00 00 00 02 00 80
   29 01 00 00 00 00 0C CB 00 00 00 00 00 00 00 00 00 00 00
   29 01 00 00 00 00 02 00 90
   29 01 00 00 00 00 10 CB 00 00 00 00 00 00 00 00 00 00 00 00 00 00 00
   29 01 00 00 00 00 02 00 A0
   29 01 00 00 00 00 10 CB 00 00 00 00 00 00 00 00 00 00 00 00 00 00 00
   29 01 00 00 00 00 02 00 B0
   29 01 00 00 00 00 10 CB 00 00 00 00 00 00 00 00 00 00 00 00 00 00 00
   29 01 00 00 00 00 02 00 C0
   29 01 00 00 00 00 10 CB 05 05 05 05 05 05 05 05 05 00 00 00 00 00 00
   29 01 00 00 00 00 02 00 D0
   29 01 00 00 00 00 10 CB 05 00 00 00 00 00 00 05 05 05 05 05 05 05 05
   29 01 00 00 00 00 02 00 E0
   29 01 00 00 00 00 0F CB 05 00 00 00 00 00 00 05 00 00 00 00 00 00
   29 01 00 00 00 00 02 00 F0
   29 01 00 00 00 00 0C CB FF FF FF FF FF FF FF FF FF FF FF
   29 01 00 00 00 00 02 00 80
   29 01 00 00 00 00 10 CC 2E 2D 29 2A 0A 0C 0E 10 02 00 00 00 00 00 00
   29 01 00 00 00 00 02 00 90
   29 01 00 00 00 00 10 CC 04 00 00 00 00 00 00 2E 2D 29 2A 09 0B 0D 0F
   29 01 00 00 00 00 02 00 A0
   29 01 00 00 00 00 0F CC 01 00 00 00 00 00 00 03 00 00 00 00 00 00
   29 01 00 00 00 00 02 00 B0
   29 01 00 00 00 00 10 CC 2D 2E 29 2A 0F 0D 0B 09 03 00 00 00 00 00 00
   29 01 00 00 00 00 02 00 C0
   29 01 00 00 00 00 10 CC 01 00 00 00 00 00 00 2D 2E 29 2A 10 0E 0C 0A
   29 01 00 00 00 00 02 00 D0
   29 01 00 00 00 00 0F CC 04 00 00 00 00 00 00 02 00 00 00 00 00 00
   29 01 00 00 00 00 02 00 B5
   29 01 00 00 00 00 07 C5 0F 81 FF 0F 81 FF
   29 01 00 00 00 00 02 00 80
   29 01 00 00 00 00 0D CE 8B 03 18 8A 03 18 89 03 18 88 03 18
   29 01 00 00 00 00 02 00 90
   29 01 00 00 00 00 0F CE 34 FD 18 34 FF 18 00 00 00 00 00 00 00 00
   29 01 00 00 00 00 02 00 A0
   29 01 00 00 00 00 0F CE 38 03 05 01 00 25 00 38 02 05 02 00 25 00
   29 01 00 00 00 00 02 00 B0
   29 01 00 00 00 00 0F CE 38 01 05 03 00 25 00 38 00 05 04 00 25 00
   29 01 00 00 00 00 02 00 C0
   29 01 00 00 00 00 0F CE 38 07 04 FD 00 25 00 38 06 04 FE 00 25 00
   29 01 00 00 00 00 02 00 D0
   29 01 00 00 00 00 0F CE 38 05 04 FF 00 25 00 38 04 05 00 00 25 00
   29 01 00 00 00 00 02 00 80
   29 01 00 00 00 00 0F CF 00 00 00 00 00 00 00 00 00 00 00 00 00 00
   29 01 00 00 00 00 02 00 90
   29 01 00 00 00 00 0F CF 00 00 00 00 00 00 00 00 00 00 00 00 00 00
   29 01 00 00 00 00 02 00 A0
   29 01 00 00 00 00 0F CF 00 00 00 00 00 00 00 00 00 00 00 00 00 00
   29 01 00 00 00 00 02 00 B0
   29 01 00 00 00 00 0F CF 00 00 00 00 00 00 00 00 00 00 00 00 00 00
   29 01 00 00 00 00 02 00 C0
   29 01 00 00 00 00 0C CF 3D 02 15 20 00 00 01 80 00 0A 65
   29 01 00 00 00 00 02 00 90
   29 01 00 00 00 00 05 F5 02 11 02 15
   29 01 00 00 00 00 02 00 90
   29 01 00 00 00 00 02 C5 50
   29 01 00 00 00 00 02 00 94
   29 01 00 00 00 00 04 C5 77 33 30
   29 01 00 00 00 00 02 00 97
   29 01 00 00 00 00 02 C5 30
   29 01 00 00 00 00 02 00 B2
   29 01 00 00 00 00 03 F5 00 00
   29 01 00 00 00 00 02 00 B4
   29 01 00 00 00 00 03 F5 00 00
   29 01 00 00 00 00 02 00 B6
   29 01 00 00 00 00 03 F5 00 00
   29 01 00 00 00 00 02 00 B8
   29 01 00 00 00 00 03 F5 00 00
   29 01 00 00 00 00 02 00 94
   29 01 00 00 00 00 03 F5 00 00
   29 01 00 00 00 00 02 00 D2
   29 01 00 00 00 00 03 F5 06 15
   29 01 00 00 00 00 02 00 B4
   29 01 00 00 00 00 02 C5 CC
   29 01 00 00 00 00 02 00 00
   29 01 00 00 00 00 15 E1 00 1B 25 33 42 4F 51 7A 6A 84 7E 68 79 54 52 46 38 2D 21 00
   29 01 00 00 00 00 02 00 00
   29 01 00 00 00 00 15 E2 00 1B 25 33 42 4F 51 7A 6A 84 7E 68 79 54 52 46 38 2D 21 00
   29 01 00 00 00 00 02 00 00
   29 01 00 00 00 00 04 FF FF FF FF
   05 01 00 00 C8 00 02 11 00
   05 01 00 00 C8 00 02 29 00];
		qcom,mdss-dsi-off-command = [05 01 00 00 32 00 02 28 00
					05 01 00 00 78 00 02 10 00];
		qcom,mdss-dsi-on-command-state = "dsi_lp_mode";
		qcom,mdss-dsi-off-command-state = "dsi_hs_mode";
		qcom,mdss-dsi-h-sync-pulse = <1>;
		qcom,mdss-dsi-traffic-mode = "burst_mode";
		qcom,mdss-dsi-lane-map = "lane_map_0123";
		qcom,mdss-dsi-bllp-eof-power-mode;
		qcom,mdss-dsi-bllp-power-mode;
		qcom,mdss-dsi-lane-0-state;
		qcom,mdss-dsi-lane-1-state;
		qcom,mdss-dsi-lane-2-state;
		qcom,mdss-dsi-lane-3-state;
		qcom,mdss-dsi-panel-timings = [92 1A 12 00 3E 42 16 1E 14 03 04 00];
		qcom,mdss-dsi-t-clk-post = <0x04>;
		qcom,mdss-dsi-t-clk-pre = <0x1C>;
		qcom,mdss-dsi-bl-min-level = <1>;
		qcom,mdss-dsi-bl-max-level = <255>;
		qcom,mdss-dsi-dma-trigger = "trigger_sw";
		qcom,mdss-dsi-mdp-trigger = "none";
		qcom,mdss-dsi-bl-pmic-control-type = "bl_ctrl_dcs";
		qcom,mdss-dsi-reset-sequence = <1 10>, <0 10>, <1 10>;
                qcom,mdss-pan-physical-width-dimension = <68>; //width of picture in mm (for xdpi)
		qcom,mdss-pan-physical-height-dimension = <121>; //height of picture in mm (for ydpi)
	};
};
