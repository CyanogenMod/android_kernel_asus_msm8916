/* Copyright (c) 2013, The Linux Foundation. All rights reserved.
 *
 * This program is free software; you can redistribute it and/or modify
 * it under the terms of the GNU General Public License version 2 and
 * only version 2 as published by the Free Software Foundation.
 *
 * This program is distributed in the hope that it will be useful,
 * but WITHOUT ANY WARRANTY; without even the implied warranty of
 * MERCHANTABILITY or FITNESS FOR A PARTICULAR PURPOSE.  See the
 * GNU General Public License for more details.
 */

/*---------------------------------------------------------------------------
 * This file is autogenerated file using gcdb parser. Please do not edit it.
 * Update input XML file to add a new entry or update variable in this file
 * VERSION = "1.0"
 *---------------------------------------------------------------------------*/
&mdss_mdp {
	dsi_tm_otm1901a_1080p_video: qcom,mdss_dsi_tm_otm1901a_1080p_video {
		qcom,mdss-dsi-panel-name = "tm otm1901a 1080p video mode dsi panel";
		qcom,mdss-dsi-panel-controller = <&mdss_dsi0>;
		qcom,mdss-dsi-panel-type = "dsi_video_mode";
		qcom,mdss-dsi-panel-destination = "display_1";
		qcom,mdss-dsi-panel-framerate = <60>;
		qcom,mdss-dsi-virtual-channel-id = <0>;
		qcom,mdss-dsi-stream = <0>;
		qcom,mdss-dsi-panel-width = <1080>;
		qcom,mdss-dsi-panel-height = <1920>;
		qcom,mdss-dsi-h-front-porch = <52>;
		qcom,mdss-dsi-h-back-porch = <52>;
		qcom,mdss-dsi-h-pulse-width = <4>;
		qcom,mdss-dsi-h-sync-skew = <0>;
		qcom,mdss-dsi-v-back-porch = <7>;
		qcom,mdss-dsi-v-front-porch = <8>;
		qcom,mdss-dsi-v-pulse-width = <1>;
		qcom,mdss-dsi-h-left-border = <0>;
		qcom,mdss-dsi-h-right-border = <0>;
		qcom,mdss-dsi-v-top-border = <0>;
		qcom,mdss-dsi-v-bottom-border = <0>;
		qcom,mdss-dsi-bpp = <24>;
		qcom,mdss-dsi-color-order = "rgb_swap_rgb";
		qcom,mdss-dsi-underflow-color = <0xff>;
		qcom,mdss-dsi-border-color = <0>;
		qcom,mdss-dsi-on-command = [29 01 00 00 00 00 02 00 00
				29 01 00 00 0A 00 05 FF 19 01 01 00
				29 01 00 00 00 00 02 00 80
				29 01 00 00 0A 00 03 FF 19 01
				29 01 00 00 00 00 02 00 00
				29 01 00 00 00 00 02 1C 33
				29 01 00 00 00 00 02 00 A0
				29 01 00 00 00 00 02 C1 00
				29 01 00 00 00 00 02 00 00
				29 01 00 00 00 00 02 35 00
				29 01 00 00 00 00 02 00 B0
				29 01 00 00 00 00 02 CA 10
				29 01 00 00 00 00 02 00 90
				29 01 00 00 00 00 0A CA B9 FF B9 FF B9 FF 53 53 53
				29 01 00 00 00 00 02 00 00
				29 01 00 00 00 00 02 C6 10
				29 01 00 00 00 00 13 C7 A0 AC CA BC 9A B9 BA CC DA 8C FA 8C 67 45 23 11 11 11
				29 01 00 00 00 00 02 00 00
				29 01 00 00 00 00 02 C6 11
				29 01 00 00 00 00 13 C7 A0 AB CA AC A9 A9 BA DA BA 8D E9 8B 78 56 34 12 11 11
				29 01 00 00 00 00 02 00 00
				29 01 00 00 00 00 02 C6 12
				29 01 00 00 00 00 13 C7 A0 AA BA AC 99 A9 AA BB AB AC C8 8B 88 56 34 22 22 22
				29 01 00 00 00 00 02 00 00
				29 01 00 00 00 00 02 C6 13
				29 01 00 00 00 00 13 C7 90 9B BA AB 99 A9 A9 BA AB BA B8 8B 88 67 45 33 22 22
				29 01 00 00 00 00 02 00 00
				29 01 00 00 00 00 02 C6 14
				29 01 00 00 00 00 13 C7 90 9A AA AB 99 99 AA A9 9C AA A9 8A 88 78 45 33 33 33
				29 01 00 00 00 00 02 00 00
				29 01 00 00 00 00 02 C6 15
				29 01 00 00 00 00 13 C7 90 9A A9 BA 98 99 A9 A9 AB A8 9B 89 88 78 56 44 34 33
				29 01 00 00 00 00 02 00 00
				29 01 00 00 00 00 02 C6 16
				29 01 00 00 00 00 13 C7 90 99 9A AA 89 99 99 9A BA 98 BA 88 88 88 57 44 44 44
				29 01 00 00 00 00 02 00 00
				29 01 00 00 00 00 02 C6 17
				29 01 00 00 00 00 13 C7 90 99 99 AA 98 98 99 8A CA 78 D9 87 88 88 67 55 45 44
				29 01 00 00 00 00 02 00 00
				29 01 00 00 00 00 02 C6 18
				29 01 00 00 00 00 13 C7 80 99 99 9A 99 88 99 8A B9 79 D9 87 88 88 67 55 55 55
				29 01 00 00 00 00 02 00 00
				29 01 00 00 00 00 02 C6 19
				29 01 00 00 00 00 13 C7 80 99 99 99 98 98 98 89 AA 7A C7 89 88 88 78 56 55 55
				29 01 00 00 00 00 02 00 00
				29 01 00 00 00 00 02 C6 1A
				29 01 00 00 00 00 13 C7 80 98 99 99 88 89 89 89 A9 89 B7 8A 88 88 78 66 66 55
				29 01 00 00 00 00 02 00 00 
				29 01 00 00 00 00 02 C6 1B
				29 01 00 00 00 00 13 C7 80 98 98 99 88 89 88 89 99 7A A7 8A 88 88 88 67 66 66
				29 01 00 00 00 00 02 00 00
				29 01 00 00 00 00 02 C6 1C
				29 01 00 00 00 00 13 C7 80 98 98 99 88 89 88 89 99 7A A7 8A 88 88 88 67 66 66
				29 01 00 00 00 00 02 00 00
				29 01 00 00 00 00 02 C6 1D
				29 01 00 00 00 00 13 C7 80 88 89 89 89 88 89 98 98 89 97 8A 88 88 88 77 77 66
				29 01 00 00 00 00 02 00 00
				29 01 00 00 00 00 02 C6 1E
				29 01 00 00 00 00 13 C7 80 88 98 88 89 88 88 89 98 98 87 89 88 88 88 88 77 77
				29 01 00 00 00 00 02 00 00
				29 01 00 00 00 00 02 C6 1F
				29 01 00 00 00 00 13 C7 80 88 88 88 98 97 88 88 98 98 87 88 88 88 88 88 88 78
				29 01 00 00 00 00 02 00 00
				29 01 00 00 00 00 02 C6 00
				29 01 00 00 00 00 02 00 00
				29 01 00 00 00 00 04 FF FF FF FF
				29 01 00 00 00 00 02 51 23
				29 01 00 00 00 00 02 53 24
				29 01 00 00 00 00 02 55 02
				29 01 00 00 00 00 02 5E 0C
				05 01 00 00 78 00 02 11 00
					05 01 00 00 00 00 02 29 00];
		qcom,mdss-dsi-off-command = [05 01 00 00 32 00 02 10 00
					29 01 00 00 00 00 02 53 00
					05 01 00 00 0A 00 02 28 00];
		qcom,mdss-dsi-on-command-state = "dsi_lp_mode";
		qcom,mdss-dsi-off-command-state = "dsi_lp_mode";
		qcom,mdss-dsi-h-sync-pulse = <1>;
		qcom,mdss-dsi-traffic-mode = "burst_mode";
		qcom,mdss-dsi-bllp-eof-power-mode;
		qcom,mdss-dsi-bllp-power-mode;
		qcom,mdss-dsi-lane-map = "lane_map_0123";
		qcom,mdss-dsi-lane-0-state;
		qcom,mdss-dsi-lane-1-state;
		qcom,mdss-dsi-lane-2-state;
		qcom,mdss-dsi-lane-3-state;
		qcom,mdss-dsi-panel-timings = [DB 36 22 00 62 66 28 3A 2B 03 04 00];
		qcom,mdss-dsi-t-clk-post = <0x03>;
		qcom,mdss-dsi-t-clk-pre = <0x29>;
		qcom,mdss-dsi-bl-min-level = <1>;
		qcom,mdss-dsi-bl-max-level = <255>;
		qcom,mdss-dsi-bl-pmic-pwm-frequency = <100>;
		qcom,mdss-dsi-bl-pmic-bank-select = <0>;
		qcom,mdss-dsi-dma-trigger = "trigger_sw";
		qcom,mdss-dsi-mdp-trigger = "none";
		qcom,mdss-dsi-bl-pmic-control-type = "bl_ctrl_dcs";
		qcom,mdss-dsi-reset-sequence = <1 1>, <0 1>, <1 5>;
		qcom,mdss-dsi-lp11-init;
		qcom,esd-check-enabled;
	        qcom,mdss-dsi-panel-status-command = [06 01 00 01 05 00 02 0A 00];
        	qcom,mdss-dsi-panel-status-command-state = "dsi_hs_mode";
	        qcom,mdss-dsi-panel-status-check-mode = "reg_read";
        	qcom,mdss-dsi-panel-status-value = <0x9C>;
		qcom,mdss-pan-physical-width-dimension = <74>; //width of picture in mm (for xdpi)
		qcom,mdss-pan-physical-height-dimension = <132>; //height of picture in mm (for ydpi)
	};
};
