/* Copyright (c) 2013-2014, The Linux Foundation. All rights reserved.
 *
 * This program is free software; you can redistribute it and/or modify
 * it under the terms of the GNU General Public License version 2 and
 * only version 2 as published by the Free Software Foundation.
 *
 * This program is distributed in the hope that it will be useful,
 * but WITHOUT ANY WARRANTY; without even the implied warranty of
 * MERCHANTABILITY or FITNESS FOR A PARTICULAR PURPOSE.  See the
 * GNU General Public License for more details.
 */

/*---------------------------------------------------------------------------
 * This file is autogenerated file using gcdb parser. Please do not edit it.
 * Update input XML file to add a new entry or update variable in this file
 * VERSION = "1.0"
 *---------------------------------------------------------------------------*/
&mdss_mdp {
	dsi_ivo_nt35521s_720p_video: qcom,mdss_dsi_ivo_nt35521s_720p_video {
		qcom,mdss-dsi-panel-name = "ivo nt35521s 720p video mode dsi panel";
		qcom,mdss-dsi-panel-controller = <&mdss_dsi0>;
		qcom,mdss-dsi-panel-type = "dsi_video_mode";
		qcom,mdss-dsi-panel-destination = "display_1";
		qcom,mdss-dsi-panel-framerate = <60>;
		qcom,mdss-dsi-virtual-channel-id = <0>;
		qcom,mdss-dsi-stream = <0>;
		qcom,mdss-dsi-panel-width = <720>;
		qcom,mdss-dsi-panel-height = <1280>;
		qcom,mdss-dsi-h-front-porch = <40>;
		qcom,mdss-dsi-h-back-porch = <40>;
		qcom,mdss-dsi-h-pulse-width = <4>;
		qcom,mdss-dsi-h-sync-skew = <0>;
		qcom,mdss-dsi-v-back-porch = <20>;
		qcom,mdss-dsi-v-front-porch = <20>;
		qcom,mdss-dsi-v-pulse-width = <2>;
		qcom,mdss-dsi-h-left-border = <0>;
		qcom,mdss-dsi-h-right-border = <0>;
		qcom,mdss-dsi-v-top-border = <0>;
		qcom,mdss-dsi-v-bottom-border = <0>;
		qcom,mdss-dsi-bpp = <24>;
		qcom,mdss-dsi-color-order = "rgb_swap_rgb";
		qcom,mdss-dsi-underflow-color = <0xff>;
		qcom,mdss-dsi-border-color = <0>;
		qcom,mdss-dsi-on-command = [29 01 00 00 00 00 05 FF AA 55 A5 80 
29 01 00 00 00 00 03 6F 11 00 
29 01 00 00 00 00 03 F7 20 00 
29 01 00 00 00 00 02 6F 11 
29 01 00 00 00 00 02 F3 01 
29 01 00 00 00 00 05 FF AA 55 25 01 
29 01 00 00 00 00 02 FC 20 
29 01 00 00 00 00 05 FF AA 55 25 00 
29 01 00 00 00 00 06 F0 55 AA 52 08 00 
29 01 00 00 00 00 02 6F 02 
29 01 00 00 00 00 02 B8 01 
29 01 00 00 00 00 03 BC 00 00 
29 01 00 00 00 00 02 C8 80 
29 01 00 00 00 00 02 B6 06 
29 01 00 00 00 00 06 F0 55 AA 52 08 01 
29 01 00 00 00 00 03 B0 09 09 
29 01 00 00 00 00 03 B1 09 09 
29 01 00 00 00 00 03 BC A0 00 
29 01 00 00 00 00 03 BD A0 00 
29 01 00 00 00 00 02 CA 00 
29 01 00 00 00 00 02 C0 04 
29 01 00 00 00 00 03 B5 03 03 
29 01 00 00 00 00 03 B3 28 28 
29 01 00 00 00 00 03 B4 0F 0F 
29 01 00 00 00 00 03 B9 34 34 
29 01 00 00 00 00 03 BA 15 15 
29 01 00 00 00 00 06 F0 55 AA 52 08 02 
29 01 00 00 00 00 02 EE 00 
29 01 00 00 00 00 11 B0 00 00 00 46 00 7d 00 9b 00 be 00 eb 01 13 01 4a 
29 01 00 00 00 00 11 B1 01 72 01 ad 01 d8 02 16 02 4a 02 4b 02 7b 02 af 
29 01 00 00 00 00 11 B2 02 d4 03 08 03 2a 03 54 03 71 03 9c 03 b1 03 ca 
29 01 00 00 00 00 05 B3 03 dd 03 c5 
29 01 00 00 00 00 11 B4 00 00 00 46 00 7d 00 9b 00 be 00 eb 01 13 01 4a
29 01 00 00 00 00 11 B5 01 72 01 ad 01 d8 02 16 02 4a 02 4b 02 7b 02 af 
29 01 00 00 00 00 11 B6 02 d4 03 08 03 2a 03 54 03 71 03 9c 03 b1 03 ca 
29 01 00 00 00 00 05 B7 03 dd 03 c5 
29 01 00 00 00 00 11 B8 00 00 00 46 00 7d 00 9b 00 be 00 eb 01 13 01 4a 
29 01 00 00 00 00 11 B9 01 72 01 ad 01 d8 02 16 02 4a 02 4b 02 7b 02 af 
29 01 00 00 00 00 11 BA 02 d4 03 08 03 2a 03 54 03 71 03 9c 03 b1 03 ca 
29 01 00 00 00 00 05 BB 03 DD 03 c5 
29 01 00 00 00 00 11 BC 00 50 00 4c 00 7d 00 9b 00 be 00 eb 01 13 01 4a 
29 01 00 00 00 00 11 BD 01 72 01 ad 01 d8 02 16 02 4a 02 4b 02 7b 02 af 
29 01 00 00 00 00 11 BE 02 d4 03 08 03 2a 03 54 03 71 03 9c 03 b1 03 ca 
29 01 00 00 00 00 05 BF 03 DD 03 fb 
29 01 00 00 00 00 11 C0 00 50 00 4c 00 7d 00 9b 00 be 00 eb 01 13 01 4a 
29 01 00 00 00 00 11 C1 01 72 01 ad 01 d8 02 16 02 4a 02 4b 02 7b 02 af 
29 01 00 00 00 00 11 C2 02 d4 03 08 03 2a 03 54 03 71 03 9c 03 b1 03 ca 
29 01 00 00 00 00 05 C3 03 DD 03 fb 
29 01 00 00 00 00 11 C4 00 50 00 4c 00 7d 00 9b 00 be 00 eb 01 13 01 4a 
29 01 00 00 00 00 11 C5 01 72 01 ad 01 d8 02 16 02 4a 02 4b 02 7b 02 af 
29 01 00 00 00 00 11 C6 02 d4 03 08 03 2a 03 54 03 71 03 9c 03 b1 03 ca 
29 01 00 00 00 00 05 C7 03 DD 03 FB 
29 01 00 00 00 00 02 6F 0A 
29 01 00 00 00 00 02 F7 02 
29 01 00 00 00 00 02 6F 00 
29 01 00 00 00 00 02 F4 03 
29 01 00 00 00 00 02 6F 12 
29 01 00 00 00 00 02 F4 3E 
29 01 00 00 00 00 02 6F 17 
29 01 00 00 00 00 02 F4 70 
29 01 00 00 00 00 06 F0 55 AA 52 08 06 
29 01 00 00 00 00 03 B0 0B 09 
29 01 00 00 00 00 03 B1 19 17 
29 01 00 00 00 00 03 B2 13 11 
29 01 00 00 00 00 03 B3 31 31 
29 01 00 00 00 00 03 B4 31 34 
29 01 00 00 00 00 03 B5 34 34 
29 01 00 00 00 00 03 B6 34 34 
29 01 00 00 00 00 03 B7 34 34 
29 01 00 00 00 00 03 B8 01 03 
29 01 00 00 00 00 03 B9 34 34 
29 01 00 00 00 00 03 BA 34 34 
29 01 00 00 00 00 03 BB 02 00 
29 01 00 00 00 00 03 BC 34 34 
29 01 00 00 00 00 03 BD 34 34 
29 01 00 00 00 00 03 BE 34 34 
29 01 00 00 00 00 03 BF 31 31 
29 01 00 00 00 00 03 C0 31 31 
29 01 00 00 00 00 03 C1 10 12 
29 01 00 00 00 00 03 C2 16 18 
29 01 00 00 00 00 03 C3 08 0A 
29 01 00 00 00 00 03 E5 31 31 
29 01 00 00 00 00 03 C4 00 02 
29 01 00 00 00 00 03 C5 16 18 
29 01 00 00 00 00 03 C6 10 12 
29 01 00 00 00 00 03 C7 31 31 
29 01 00 00 00 00 03 C8 31 34 
29 01 00 00 00 00 03 C9 34 34 
29 01 00 00 00 00 03 CA 34 34 
29 01 00 00 00 00 03 CB 34 34 
29 01 00 00 00 00 03 CC 0A 08 
29 01 00 00 00 00 03 CD 34 34 
29 01 00 00 00 00 03 CE 34 34 
29 01 00 00 00 00 03 CF 09 0b 
29 01 00 00 00 00 03 D0 34 34 
29 01 00 00 00 00 03 D1 34 34 
29 01 00 00 00 00 03 D2 34 34 
29 01 00 00 00 00 03 D3 31 31 
29 01 00 00 00 00 03 D4 31 31 
29 01 00 00 00 00 03 D5 13 11 
29 01 00 00 00 00 03 D6 19 17 
29 01 00 00 00 00 03 D7 03 01 
29 01 00 00 00 00 06 D8 00 00 00 00 00 
29 01 00 00 00 00 06 D9 00 00 00 00 00 
29 01 00 00 00 00 02 E7 00 
29 01 00 00 00 00 06 F0 55 AA 52 08 05 
29 01 00 00 00 00 02 ED 30 
29 01 00 00 00 00 06 F0 55 AA 52 08 03 
29 01 00 00 00 00 03 B1 f0 00 
29 01 00 00 00 00 03 B0 f5 01
29 01 00 00 00 00 02 ef 01
29 01 00 00 00 00 06 F0 55 AA 52 08 05 
29 01 00 00 00 00 02 E5 00 
29 01 00 00 00 00 06 F0 55 AA 52 08 05 
29 01 00 00 00 00 03 B0 17 06 
29 01 00 00 00 00 02 B8 00 
29 01 00 00 00 00 06 BD 03 03 03 00 03 
29 01 00 00 00 00 03 B1 17 06 
29 01 00 00 00 00 03 B9 00 03 
29 01 00 00 00 00 03 B2 17 06 
29 01 00 00 00 00 03 BA 00 00 
29 01 00 00 00 00 03 B3 17 06 
29 01 00 00 00 00 03 BB 00 00 
29 01 00 00 00 00 03 B4 17 06 
29 01 00 00 00 00 03 B5 17 06 
29 01 00 00 00 00 03 B6 17 06 
29 01 00 00 00 00 03 B7 17 06 
29 01 00 00 00 00 03 BC 00 03 
29 01 00 00 00 00 02 E5 06 
29 01 00 00 00 00 02 E6 06 
29 01 00 00 00 00 02 E7 06 
29 01 00 00 00 00 02 E8 06 
29 01 00 00 00 00 02 E9 06 
29 01 00 00 00 00 02 EA 06 
29 01 00 00 00 00 02 EB 06 
29 01 00 00 00 00 02 EC 06 
29 01 00 00 00 00 06 F0 55 AA 52 08 05 
29 01 00 00 00 00 02 C0 07 
29 01 00 00 00 00 02 C1 05 
29 01 00 00 00 00 02 C2 07 
29 01 00 00 00 00 02 C3 05 
29 01 00 00 00 00 06 F0 55 AA 52 08 03 
29 01 00 00 00 00 06 B2 05 00 00 00 00 
29 01 00 00 00 00 06 B3 05 00 00 00 00 
29 01 00 00 00 00 06 B4 05 00 00 00 00 
29 01 00 00 00 00 06 B5 05 00 00 00 00 
29 01 00 00 00 00 06 F0 55 AA 52 08 05 
29 01 00 00 00 00 02 C4 82 
29 01 00 00 00 00 02 C5 80 
29 01 00 00 00 00 02 C6 83 
29 01 00 00 00 00 02 C7 81 
29 01 00 00 00 00 06 F0 55 AA 52 08 03 
29 01 00 00 00 00 06 B6 05 00 00 00 00 
29 01 00 00 00 00 06 B7 05 00 00 00 00 
29 01 00 00 00 00 06 B8 05 00 00 00 00 
29 01 00 00 00 00 06 B9 05 00 00 00 00 
29 01 00 00 00 00 06 F0 55 AA 52 08 05 
29 01 00 00 00 00 03 C8 0D 20 
29 01 00 00 00 00 03 C9 09 20 
29 01 00 00 00 00 03 CA 0D 00 
29 01 00 00 00 00 03 CB 09 00 
29 01 00 00 00 00 06 F0 55 AA 52 08 03 
29 01 00 00 00 00 06 BA 53 00 fa 00 00 
29 01 00 00 00 00 06 BB 53 00 fa 00 00 
29 01 00 00 00 00 06 BC 53 00 00 00 00 
29 01 00 00 00 00 06 BD 53 00 00 00 00 
29 01 00 00 00 00 06 F0 55 AA 52 08 05 
29 01 00 00 00 00 06 D1 01 05 03 07 10 
29 01 00 00 00 00 06 D2 01 05 07 07 10 
29 01 00 00 00 00 06 D3 00 00 0A 07 10 
29 01 00 00 00 00 06 D4 00 00 0A 07 10 
29 01 00 00 00 00 06 F0 55 AA 52 08 05 
29 01 00 00 00 00 08 D0 00 00 00 00 00 00 00 
29 01 00 00 00 00 0C D5 00 00 00 00 00 00 00 00 00 00 00 
29 01 00 00 00 00 0C D6 00 00 00 00 00 00 00 00 00 00 00 
29 01 00 00 00 00 0C D7 00 00 00 00 00 00 00 00 00 00 00 
29 01 00 00 00 00 06 D8 00 00 00 00 00 
29 01 00 00 00 00 06 F0 55 AA 52 08 03 
29 01 00 00 00 00 02 C4 60 
29 01 00 00 00 00 02 C5 40 
29 01 00 00 00 00 02 C6 60 
29 01 00 00 00 00 02 C7 40 
29 01 00 00 00 00 02 6F 11 
29 01 00 00 00 00 02 F3 01 
29 01 00 00 00 00 06 F0 55 AA 52 00 00 
29 01 00 00 00 00 05 FF AA 55 A5 00
29 01 00 00 00 00 02 51 23
29 01 00 00 00 00 02 53 2C
				05 01 00 00 C8 00 02 11 00
				05 01 00 00 78 00 02 29 00];
				qcom,mdss-dsi-off-command = [05 01 00 00 32 00 02 28 00 
				05 01 00 00 78 00 02 10 00];
		qcom,mdss-dsi-on-command-state = "dsi_lp_mode";
		qcom,mdss-dsi-off-command-state = "dsi_hs_mode";
		qcom,mdss-dsi-h-sync-pulse = <1>;
		qcom,mdss-dsi-traffic-mode = "burst_mode";
		qcom,mdss-dsi-bllp-eof-power-mode;
		qcom,mdss-dsi-bllp-power-mode;
		qcom,mdss-dsi-lane-0-state;
		qcom,mdss-dsi-lane-1-state;
		qcom,mdss-dsi-lane-2-state;
		qcom,mdss-dsi-lane-3-state;
		qcom,mdss-dsi-panel-timings = [75 18 10 00 3A 3E 14 1A 13 03 04 00];
		qcom,mdss-dsi-t-clk-post = <0x04>;
		qcom,mdss-dsi-t-clk-pre = <0x25>;
		qcom,mdss-dsi-bl-min-level = <1>;
		qcom,mdss-dsi-bl-max-level = <255>;
		qcom,mdss-dsi-bl-pmic-pwm-frequency = <100>;
		qcom,mdss-dsi-bl-pmic-bank-select = <0>;
		qcom,mdss-dsi-pwm-gpio = <&pm8916_mpps 4 0>;
		qcom,mdss-dsi-dma-trigger = "trigger_sw";
		qcom,mdss-dsi-mdp-trigger = "none";
		qcom,mdss-dsi-bl-pmic-control-type = "bl_ctrl_dcs";
		qcom,mdss-dsi-reset-sequence = <1 1>, <0 50>, <1 50>;
		qcom,mdss-dsi-lp11-init;
		qcom,mdss-pan-physical-width-dimension = <74>; //width of picture in mm (for xdpi)
		qcom,mdss-pan-physical-height-dimension = <132>; //height of picture in mm (for ydpi)
	};
};
